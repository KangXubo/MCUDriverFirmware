# GD32A72_A74x register map
File version: 1.0
GD32A72_A74x ARM 32-bit Cortex-M7 Microcontroller based device
CPU: CM7 r2p1, little endian, MPU, FPU, DSP, 4 interrupt priority bits
Registers are 32-bit, read-write, reset 0x0 unless marked. A register's access mark holds for its fields unless they carry their own. Offsets are from the block's base; lines under a group give offsets from that group; [hi:lo] are bit positions; {n}, {i} and the like mark numbered series; 'fields as' and 'values as' point back to an identical list; <NAME> marks a mode.

## Memory map
0x40000000 TIMER20 size 0x400
0x40000400 TIMER2 size 0x400
0x40001000 TIMER60 size 0x400
0x40001400 TIMER6 size 0x400
0x40002400 CLTCFG size 0x400 — Client configuration
0x40002800 RTC size 0x400 — Real-time clock
0x40002C00 WWDGT0 size 0x400 — Window watchdog timer
0x40003000 FWDGT0 size 0x400 — Free watchdog timer
0x40003800 SPI6 size 0x400
0x40003C00 SPI7 size 0x400
0x40004400 USART3 size 0x400
0x40004800 USART4 size 0x400
0x40005400 I2C0 size 0x400 — Inter integrated circuit
0x40005800 I2C1 size 0x400
0x40006000 SENT size 0x800 — Single edge Nibble transmission
0x40006C00 BKP size 0x400 — Backup registers
0x40007000 PMU size 0x400 — Power management unit
0x40007400 DAC0 size 0x400 — Digital-to-analog converter
0x40008800 LIN6 size 0x400
0x40008C00 LIN7 size 0x400
0x40009000 LIN8 size 0x400
0x40009400 LIN9 size 0x400
0x40009800 LIN10 size 0x400
0x40009C00 LIN11 size 0x400
0x4000A000 ENET_MAC blocks up to offset 0xC00
0x4000A700 ENET_MMC size 0x200
0x4000AC00 ENET_MTL size 0x200
0x4000B000 ENET_DMA size 0x200 — ENET_DMA DMA
0x4000CC00 DAC1 size 0x400
0x4000D000 TIMER61 size 0x400
0x4000D400 TIMER63 size 0x400
0x4000DC00 WWDGT1 size 0x400
0x4000E000 FWDGT1 size 0x400
0x4000E400 SPI2 size 0x400
0x4000E800 SPI3 size 0x400
0x4000EC00 JDC size 0x400 — Debug system JDC
0x4000F000 ADC0 size 0x800 — Analog-to-digital converter
0x4000F800 ADC1 size 0x800 — Analog-to-digital converter
0x40010000 SYSCFG size 0x400 — System and memory architecture
0x40010400 EXTI size 0x400 — Interrupt / event controller
0x40010800 LIN0 size 0x400 — Local Interconnect Network
0x40010C00 LIN1 size 0x400
0x40011000 LIN2 size 0x400
0x40011400 LIN3 size 0x400
0x40011800 LIN4 size 0x400
0x40011C00 LIN5 size 0x400
0x40012000 TRIGSEL size 0x400 — Trigger selection controller
0x40012400 ADC2 size 0x800 — Analog-to-digital converter
0x40012C00 TIMER0 size 0x400 — Advanced timer
0x40013000 SPI0 size 0x400 — Serial peripheral interface
0x40013400 TIMER7 size 0x400
0x40013800 USART0 size 0x400 — Universal synchronous / asynchronous receiver / transmitter
0x40013C00 USART1 size 0x400
0x40014000 USART2 size 0x400
0x40014400 SPI4 size 0x400
0x40014800 SPI5 size 0x400
0x40015000 TIMER19 size 0x400
0x40015C00 TIMER1 size 0x400 — General level0 timer
0x40016000 TIMER5 size 0x400 — Basic timer
0x40016400 TIMER62 size 0x400
0x40016C00 CMP1 size 0x400 — Comparator
0x40017000 USART5 size 0x400
0x40017800 SPI1 size 0x400
0x40017C00 CMP0 size 0x400 — Comparator
{0x40018000+0x1000*n} CAN{n} size 0x1000 (n=0..7) — Controller area network
0x40023400 FMU size 0x400 — Fault management unit
0x40023800 IRM size 0x400 — Interrupt requests management
0x40023C00 IOC size 0x400 — Input Output Checker
0x40024400 MTC size 0x400 — Memory test controller
0x40025000 STCM size 0x400 — Self-test control module
0x40038000 PRPU size 0x400 — Peripheral register protection unit
0x40250400 GD_AP size 0x400 — Debug system GD_AP
0x48000000 GPIOA size 0x400 — General-purpose and alternate-function I/Os
0x48000400 GPIOB size 0x400 — General-purpose and alternate-function I/Os
0x48000800 GPIOC size 0x400 — General-purpose and alternate-function I/Os
0x48000C00 GPIOD size 0x400 — General-purpose and alternate-function I/Os
0x48001000 GPIOE size 0x400 — General-purpose and alternate-function I/Os
0x48001400 GPIOF size 0x400 — General-purpose and alternate-function I/Os
0x48001800 GPIOG size 0x400 — General-purpose and alternate-function I/Os
0x48001C00 GPIOH size 0x400 — General-purpose and alternate-function I/Os
0x48002000 GPIOI size 0x400 — General-purpose and alternate-function I/Os
0x48002400 GPIOJ size 0x400 — General-purpose and alternate-function I/Os
0x48002800 GPIOK size 0x400 — General-purpose and alternate-function I/Os
0x48002C00 GPIOL size 0x400 — General-purpose and alternate-function I/Os
0x48003000 GPIOM size 0x400 — General-purpose and alternate-function I/Os
0x48003400 GPION size 0x400 — General-purpose and alternate-function I/Os
0x49000000 DMA0 size 0x400 — Direct memory access controller
0x49000400 DMA1 size 0x400
0x49000800 DMAMUX size 0x400 — DMA request multiplexer
0x49000C00 SRAM size 0x400
0x49001000 CCTL size 0x400 — Clock control unit
0x49001400 QSPI size 0x400 — Quad-SPI interface
0x49001800 CPDM size 0x400 — Clock phase delay module
0x49002000 FMC size 0x400 — Flash memory controller
0x49003000 CRC size 0x400 — Cyclic redundancy checks management unit
0x49003400 MFCOM size 0x800 — Multi-function communication Interface
0x49003C00 RCTL size 0x400 — Reset control unit
0x49004000 TCM size 0x400
0x49008000 MCMUA size 0x400 — Multi-core messaging unit
0x49008400 MCMUB size 0x400 — Multi-core messaging unit
0x49008800 HWSEM size 0x400 — Hardware semaphore
0x49008C00 HSMIF size 0x400
0x49009000 BUSIM size 0x400 — Bus interconnect matrix
0x49009400 IMICU_BM1 size 0x400 — Interconnect matrix integrity check unit
0x49009800 IMICU_BM2 size 0x400
0x4900A000 EXTMPU size 0x400 — Extended memory protection unit
0xE00E1000 DBG size 0x400 — Debug

## Interrupts
0 WWDGT0
1 LVD_HVD_FROM_EXTI_Line16 (EXTI)
2 RTC_ALARM_FROM_EXTI_Line17 (EXTI)
3 RTC_GLOBAL (RTC)
4 FMC_GLOBAL (FMC)
5 RCU_CK_READY (CCTL)
6 EXTI_Line0 (EXTI)
7 EXTI_Line1 (EXTI)
8 EXTI_Line2 (EXTI)
9 EXTI_Line3 (EXTI)
10 EXTI_Line4 (EXTI)
11 DMA0_Channel0 (DMA0)
12 DMA0_Channel1 (DMA0)
13 DMA0_Channel2 (DMA0)
14 DMA0_Channel3 (DMA0)
15 DMA0_Channel4 (DMA0)
16 DMA0_Channel5 (DMA0)
17 DMA0_Channel6 (DMA0)
18 ADC0
19 CAN0_MSG_BUF (CAN0)
20 CAN0
21 CPU_TO_CPU_INT0 (SYSCFG)
22 CPU_TO_CPU_INT1 (SYSCFG)
23 CPU_TO_CPU_INT2 (SYSCFG)
24 CPU_TO_CPU_INT3 (SYSCFG)
25 CAN0_WAKEUP_FROM_EXTI_Line18 (EXTI)
26 TIMER0_BRK_UP_TRG_CM_DEC (TIMER0)
27 TIMER2_UP_TRG_CM_DEC (TIMER2)
28 TIMER1_UP_TRG_CM_DEC (TIMER1)
29 TIMER19_BRK_UP_TRG_CM_DEC (TIMER19)
30 JTAG_INT_TO_HOST (JDC)
31 I2C0_EV (I2C0)
32 I2C0_ER (I2C0)
33 I2C1_EV (I2C1)
34 I2C1_ER (I2C1)
35 SPI0
36 SPI1
37 USART0
38 USART1
39 USART2
40 EXTI_Line15_10 (EXTI)
41 EXTI_Line9_5 (EXTI)
42 Tamper (BKP)
43 TIMER20_BRK_UP_TRG_CM_DEC (TIMER20)
44 EXTI_Line101_42 (EXTI)
45 TIMER7_BRK_UP_TRG_CM_DEC (TIMER7)
46 PLL_LOL_DST_RESET (CCTL)
47 DMAMUX
48 CPU_FPU_OR_WRITE_ABORT (SYSCFG)
49 EXTI_FROM_EXTI_Line26 (EXTI)
50 EXTI_FROM_EXTI_Line27 (EXTI)
51 FMU_INIT_TIMEOUT (FMU)
52 ADC1
53 ADC2
54 DAC0
55 STCM_ILLEGAL_TRG (STCM)
56 DMA1_Channel0 (DMA1)
57 DMA2_Channel1 (DMA1)
58 DMA1_Channel2 (DMA1)
59 DMA1_Channel3 (DMA1)
60 DMA1_Channel4 (DMA1)
61 WWDGT1
62 CAN1_WAKEUP_FROM_EXTI_Line19 (EXTI)
63 CAN1_MSG_BUF (CAN1)
64 CAN1
65 CTI_INT0 (SYSCFG)
66 CTI_INT1 (SYSCFG)
67 CAN0_ECCERR (CAN0)
68 CAN1_ECCERR (CAN1)
69 CAN2_ECCERR (CAN2)
70 MFCOM
71 CMP0
72 CMP1
73 BUS (SYSCFG)
74 SENT
75 HWSEM
76 CAN3_ECCERR (CAN3)
77 CAN4_ECCERR (CAN4)
78 DAC1
79 HSM_CM_INT0 (SYSCFG)
80 HSM_CM_INT1 (SYSCFG)
81 FMU_CATION_STATE (FMU)
82 RCTL
83 IOC
84 SPI2
85 SPI3
86 SPI4
87 SPI5
88 SPI6
89 SPI7
90 QSPI
91 USART3
92 USART4
93 USART5
94 CAN2_WAKEUP_FROM_EXTI_Line20 (EXTI)
95 CAN3_WAKEUP_FROM_EXTI_Line21 (EXTI)
96 CAN4_WAKEUP_FROM_EXTI_Line22 (EXTI)
97 CAN5_WAKEUP_FROM_EXTI_Line23 (EXTI)
98 CAN6_WAKEUP_FROM_EXTI_Line24 (EXTI)
99 CAN7_WAKEUP_FROM_EXTI_Line25 (EXTI)
100 CAN2_MSG_BUF (CAN2)
101 CAN2
102 CAN3_MSG_BUF (CAN3)
103 CAN3
104 CAN4_MSG_BUF (CAN4)
105 CAN4
106 CAN5_MSG_BUF (CAN5)
107 CAN5
108 CAN6_MSG_BUF (CAN6)
109 CAN6
110 CAN7_MSG_BUF (CAN7)
111 CAN7
112 TIMER19_CC_CH0_MCH0 (TIMER19)
113 TIMER19_CC_CH1_MCH1 (TIMER19)
114 TIMER19_CC_CH2_MCH2 (TIMER19)
115 TIMER19_CC_CH3_MCH3 (TIMER19)
116 TIMER20_CC_CH0_MCH0 (TIMER20)
117 TIMER20_CC_CH1_MCH1 (TIMER20)
118 TIMER20_CC_CH2_MCH2 (TIMER20)
119 TIMER20_CC_CH3_MCH3 (TIMER20)
120 TIMER60_CC_CH0_MCH0 (TIMER60)
121 TIMER60_CC_CH1_MCH1 (TIMER60)
122 TIMER60_CC_CH2_MCH2 (TIMER60)
123 TIMER60_CC_CH3_MCH3 (TIMER60)
124 TIMER61_CC_CH0_MCH0 (TIMER61)
125 TIMER61_CC_CH1_MCH1 (TIMER61)
126 TIMER61_CC_CH2_MCH2 (TIMER61)
127 TIMER61_CC_CH3_MCH3 (TIMER61)
128 TIMER62_CC_CH0_MCH0 (TIMER62)
129 TIMER62_CC_CH1_MCH1 (TIMER62)
130 TIMER62_CC_CH2_MCH2 (TIMER62)
131 TIMER62_CC_CH3_MCH3 (TIMER62)
132 TIMER63_CC_CH0_MCH0 (TIMER63)
133 TIMER64_CC_CH1_MCH1 (TIMER63)
134 TIMER65_CC_CH2_MCH2 (TIMER63)
135 TIMER66_CC_CH3_MCH3 (TIMER63)
{n+129} DMA0_Channel{n} (DMA0) (n=7..15)
145 DMA1_Channel5 (DMA1)
146 DMA2_Channel6 (DMA1)
147 DMA1_Channel7 (DMA1)
148 DMA1_Channel8 (DMA1)
149 DMA1_Channel9 (DMA1)
150 DMA1_Channel10 (DMA1)
151 DMA2_Channel11 (DMA1)
152 DMA1_Channel12 (DMA1)
153 DMA1_Channel13 (DMA1)
154 DMA1_Channel14 (DMA1)
155 DMA1_Channel15 (DMA1)
156 MCMUA_RX_FULL (MCMUA)
157 MCMUA_TX_EMPTY (MCMUA)
158 MCMUA_GENERAL_PURPOSE (MCMUA)
159 MCMUB_RX_FULL (MCMUB)
160 MCMUB_TX_EMPTY (MCMUB)
161 MCMUB_GENERAL_PURPOSE (MCMUB)
{n+162} LIN{n} (n=0..11)
174 TIMER0_CC_CH0_MCH0 (TIMER0)
175 TIMER0_CC_CH1_MCH1 (TIMER0)
176 TIMER0_CC_CH2_MCH2 (TIMER0)
177 TIMER0_CC_CH3_MCH3 (TIMER0)
178 TIMER7_CC_CH0_MCH0 (TIMER7)
179 TIMER7_CC_CH1_MCH1 (TIMER7)
180 TIMER7_CC_CH2_MCH2 (TIMER7)
181 TIMER7_CC_CH3_MCH3 (TIMER7)
182 TIMER1_CC_CH0 (TIMER1)
183 TIMER1_CC_CH1 (TIMER1)
184 TIMER1_CC_CH2 (TIMER1)
185 TIMER1_CC_CH3 (TIMER1)
186 TIMER2_CC_CH0 (TIMER2)
187 TIMER2_CC_CH1 (TIMER2)
188 TIMER2_CC_CH2 (TIMER2)
189 TIMER2_CC_CH3 (TIMER2)
190 FWDGT_RST_FROM_EXTI_Line40 (FWDGT0)
191 ENET_GLOBAL_INT (ENET_MAC)
192 ENET_WKUP_LPI_INT (ENET_MAC)
193 ENET_TX0_TX1_INT (ENET_MAC)
194 ENET_RX0_RX1_INT (ENET_MAC)
195 ENET_SAFE_COR_UNCOR_INT (ENET_MAC)
196 RCU_CK_FAIL (CCTL)
197 CAN5_ECCERR (CAN5)
198 LIN0_WAKEUP_FROM_EXTI_Line28 (EXTI)
199 LIN1_WAKEUP_FROM_EXTI_Line29 (EXTI)
200 LI2_WAKEUP_FROM_EXTI_Line30 (EXTI)
{n+198} LIN{n}_WAKEUP_FROM_EXTI_Line{n+28} (EXTI) (n=3..11)
210 TIMER60_BRK_UP_TRG_CM_DEC (TIMER60)
211 TIMER61_BRK_UP_TRG_CM_DEC (TIMER61)
212 TIMER62_BRK_UP_TRG_CM_DEC (TIMER62)
213 TIMER63_BRK_UP_TRG_CM_DEC (TIMER63)
214 TIMER5_CH0_UP (TIMER5)
215 TIMER5_CH1_UP (TIMER5)
216 TIMER5_CH2_UP (TIMER5)
217 TIMER5_CH3_UP (TIMER5)
218 TIMER6_CH0_UP (TIMER6)
219 TIMER6_CH1_UP (TIMER6)
220 TIMER6_CH2_UP (TIMER6)
221 TIMER6_CH3_UP (TIMER6)
238 CAN6_ECCERR (CAN6)
239 CAN7_ECCERR (CAN7)
