# GD32E53x register map
File version: 1.0
GD32E53x ARM 32-bit Cortex-M33 Microcontroller based device
CPU: CM33 r0p4, little endian, MPU, FPU, 4 interrupt priority bits
Registers are 32-bit, read-write, reset 0x0 unless marked. A register's access mark holds for its fields unless they carry their own. Offsets are from the block's base; lines under a group give offsets from that group; [hi:lo] are bit positions; {n}, {i} and the like mark numbered series; 'fields as' and 'values as' point back to an identical list; <NAME> marks a mode.

## Memory map
0x40000000 TIMER1 size 0x400 — General-purpose-timers
0x40000400 TIMER2 size 0x400
0x40000800 TIMER3 size 0x400
0x40000C00 TIMER4 size 0x400
0x40001000 TIMER5 size 0x400 — Basic-timers
0x40001400 TIMER6 size 0x400
0x40001C00 TIMER12 size 0x400
0x40002000 TIMER13 size 0x400
0x40002800 RTC size 0x400 — Real time clock
0x40002C00 WWDGT size 0x400 — Window watchdog timer
0x40003000 FWDGT size 0x400 — free watchdog timer
0x40003400 I2S1_ADD size 0x400
0x40003800 SPI1 size 0x400
0x40003C00 SPI2 size 0x400
0x40004000 I2S2_ADD size 0x400
0x40004400 USART1 size 0x400
0x40004800 USART2 size 0x400 — Universal synchronous / asynchronous receiver / transmitter
0x40004C00 UART3 size 0x400 — Universal asynchronous receiver / transmitter
0x40005000 UART4 size 0x400
0x40005400 I2C0 size 0x400 — Inter-integrated circuit interface
0x40005800 I2C1 size 0x400
0x40007000 PMU size 0x400 — Power management unit
0x40007400 DAC0 size 0x400 — Digital-to-analog converter
0x4000C000 I2C2 size 0x400
0x4000C800 CTC0 size 0x400 — Clock trim controller
0x4000CC00 CTC1 size 0x400 — Clock trim controller
0x4000E000 TIMER42 size 0x400
0x4000E400 TIMER43 size 0x400
0x4000E800 TIMER44 size 0x400
0x4000EC00 TIMER50 size 0x400
0x4000F000 TIMER51 size 0x400
0x40010000 AFIO size 0x400 — Alternate-function I/Os
0x40010400 EXTI size 0x400 — External interrupt/event controller
0x40010800 GPIOA size 0x400 — General-purpose I/Os
0x40010C00 GPIOB size 0x400 — General-purpose I/Os
0x40011000 GPIOC size 0x400 — General-purpose I/Os
0x40011400 GPIOD size 0x400
0x40011800 GPIOE size 0x400
0x40011C00 CAN0 size 0x400 — Controller area network
0x40012000 CAN1 size 0x400
0x40012400 ADC0 size 0x400 — Analog-to-digital converter
0x40012800 ADC1 size 0x400
0x40012C00 TIMER0 size 0x400 — Advanced-timers
0x40013000 SPI0 size 0x400 — Serial peripheral interface/Inter-IC sound
0x40013400 TIMER7 size 0x400
0x40013800 USART0 size 0x400 — Universal synchronous / asynchronous receiver / transmitter
0x40013C00 ADC2 size 0x400
0x40014000 TIMER14 size 0x400 — General level3 timer
0x40014400 TIMER41 size 0x400
0x40014800 TIMER19 size 0x400
0x40014C00 TIMER40 size 0x400
0x40015000 TIMER9 size 0x400 — General-purpose-timers
0x40015400 TIMER10 size 0x400
0x40017000 USART5 size 0x400 — Universal synchronous / asynchronous receiver / transmitter
0x40017400 CAN2 size 0x400 — Controller area network
0x40017C00 CMP size 0x400 — Comparator
0x40018000 SDIO size 0x400 — Secure digital input/output interface
0x40018400 SPI3 size 0x400
0x40019000 TRIGSEL size 0x400 — Trigger selection controller
0x40019800 SYSCFG size 0x400 — System and memory architectur
0x40020000 DMA0 size 0x400 — Direct memory access controller
0x40020400 DMA1 size 0x400 — Direct memory access controller
0x40020800 DMAMUX size 0x400 — DMA request multiplexer
0x40021000 RCU size 0x400 — Reset and clock unit
0x40022000 FMC size 0x400 — Flash memory controller
0x40023000 CRC size 0x400 — Cyclic redundancy checks management unit
0x40023400 CAU size 0x400 — Cryptographic Acceleration Unit
0x40023800 HAU size 0x400 — HAU acceleration unit
0x40023C00 TRNG size 0x400 — True random number generator
0x40025000 OSPI size 0x400 — Octal-SPI interfac
0x40026000 ICACHE size 0x400 — Instruction cache
0x40026400 DCACHE size 0x400 — Data cache
0x50000000 USBFS_GLOBAL size 0x400 — USB full speed global registers
0x50000400 USBFS_HOST size 0x400 — USB on the go full speed host
0x50000800 USBFS_DEVICE size 0x400 — USB on the go full speed device
0x50000E00 USBFS_PWRCLK size 0x100 — USB on the go full speed
0xA0000000 EXMC size 0x1000 — External memory controller
0xE0054000 DBG size 0x400 — Debug

## Interrupts
0 WWDGT
1 VAUVD_VAOVD_LVD_OVD (PMU)
2 RTC_tamper_timestamp (RTC)
3 RTC_wakeup (RTC)
4 FMC
5 RCU_CTC (RCU)
6 EXTI_Line0 (EXTI)
7 EXTI_Line1 (EXTI)
8 EXTI_Line2 (EXTI)
9 EXTI_Line3 (EXTI)
10 EXTI_Line4 (EXTI)
11 DMA0_channel0 (DMA0)
12 DMA0_channel1 (DMA0)
13 DMA0_channel2 (DMA0)
14 DMA0_channel3 (DMA0)
15 DMA0_channel4 (DMA0)
16 DMA0_channel5 (DMA0)
17 DMA0_channel6 (DMA0)
18 ADC0_ADC1 (ADC0)
19 CAN0_transmit (CAN0)
20 CAN0_receive0 (CAN0)
21 CAN0_receive1 (CAN0)
22 CAN0_EWMC (CAN0)
23 EXTI_line9_5 (EXTI)
24 TIMER0_BRK_TIMER14 (TIMER0)
25 TIMER0_UP_TIMER9 (TIMER0)
26 TIMER0_TRG_CMT_TIMER10 (TIMER0)
27 TIMER0_CC (TIMER0)
28 TIMER1
29 TIMER2
30 TIMER3
31 I2C0_event (I2C0)
32 I2C0_error (I2C0)
33 I2C1_event (I2C1)
34 I2C1_error (I2C1)
35 SPI0
36 SPI1_I2S1ADD (SPI1)
37 USART0
38 USART1
39 USART2
40 EXTI_line15_10 (EXTI)
41 RTC_alarm (RTC)
42 USBFS_WKUP (USBFS_GLOBAL)
43 TIMER7_BRK (TIMER7)
44 TIMER7_UP_TIMER12 (TIMER7)
45 TIMER7_TRG_CMT_TIMER13 (TIMER7)
46 TIMER7_CC (TIMER7)
47 ADC2
49 SDIO
50 TIMER4
51 SPI2_I2S2ADD (SPI2)
52 UART3
53 UART4
54 TIMER5_DAC (TIMER5)
55 TIMER6
56 DMA1_channel0 (DMA1)
57 DMA1_channel1 (DMA1)
58 DMA1_channel2 (DMA1)
59 DMA1_channel3 (DMA1)
60 DMA1_channel4 (DMA1)
61 DMAMUX
63 CAN1_transmit (CAN1)
64 CAN1_receive0 (CAN1)
65 CAN1_receive1 (CAN1)
66 CAN1_EWMC (CAN1)
67 USBFS (USBFS_GLOBAL)
78 CAN2_transmit (CAN2)
79 CAN2_receive0 (CAN2)
80 CAN2_receive1 (CAN2)
81 CAN2_EWMC (CAN2)
82 I2C2_event (I2C2)
83 I2C2_error (I2C2)
84 USART5
85 I2C2_wakeup (I2C2)
86 USART5_wakeup (USART5)
87 FPU (SYSCFG)
88 TRNG
89 CAU
90 TIMER40
91 TIMER41
92 TIMER42
93 TIMER43
94 TIMER44
95 TIMER50
96 TIMER51
97 ICACHE
98 DCACHE
99 HAU
100 OSPI
101 SPI3
102 VOVD_VUVD (PMU)
103 TIMER0_BRK_Channel (TIMER0)
104 TIMER7_BRK_Channel (TIMER7)
105 SYSCFG
106 RCU_2 (RCU)
107 TIMER19_BRK (TIMER19)
108 TIMER19_UP (TIMER19)
109 TIMER19_TRG_CMT (TIMER19)
110 TIMER19_CC (TIMER19)
111 TIMER19_BRK_Channel (TIMER19)
112 CMP
113 CMP0_wakeup (CMP)
114 CMP1_wakeup (CMP)
