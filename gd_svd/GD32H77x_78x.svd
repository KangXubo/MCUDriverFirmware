# GD32H77x_78x register map
File version: 1.0
GD32H77x_78x ARM 32-bit Cortex-M7 Microcontroller based device
CPU: CM7 r1p2, little endian, MPU, FPU, 4 interrupt priority bits
Registers are 32-bit, read-write, reset 0x0 unless marked. A register's access mark holds for its fields unless they carry their own. Offsets are from the block's base; lines under a group give offsets from that group; [hi:lo] are bit positions; {n}, {i} and the like mark numbered series; 'fields as' and 'values as' point back to an identical list; <NAME> marks a mode.

## Memory map
0x40000000 TIMER1 size 0x400 — General-purpose-timers
0x40000400 TIMER2 size 0x400 — General-purpose-timers
0x40000800 TIMER3 size 0x400
0x40000C00 TIMER4 size 0x400
0x40001000 TIMER5 size 0x400 — Basic-timers
0x40001400 TIMER6 size 0x400
0x40003800 SPI1 size 0x400 — Serial peripheral interface/Inter-IC sound
0x40003C00 SPI2 size 0x400 — Serial peripheral interface/Inter-IC sound
0x40004000 RSPDIF size 0x400 — Receiver of Sony/Philips Digtial Interface
0x40004400 USART1 size 0x400
0x40004800 USART2 size 0x400
0x40004C00 UART3 size 0x400 — Universal receiver /transmitter
0x40005000 UART4 size 0x400
0x40005400 I2C0 size 0x400 — Inter integrated circuit
0x40005800 I2C1 size 0x400
0x40005C00 I2C3 size 0x400
0x40007400 DAC0 size 0x400 — Digital-to-analog converter
0x40007800 UART6 size 0x400
0x40007C00 UART7 size 0x400
0x40008400 CTC size 0x400 — Clock trim controller
0x40009400 MDIO size 0x400 — Management data input/output
0x4000C000 I2C2 size 0x400
0x4000C400 AFMT size 0x400 — A-format encoder interface module
0x4000C800 TFMT size 0x400 — Tamagawa format encoder interface module
0x4000CC00 ENDAT size 0x400 — EnDat 2.2 encoder interface module
0x4000D000 BISS size 0x400 — BiSS-C encoder interface module
0x4000D800 HDSL size 0x100 — HIPERFACE DSL encoder interface module
0x4000DA00 SAFE_CHANNEL_1 size 0x100 — HDSL Safe Channel 1 Interface
0x4000DB00 SAFE_CHANNEL_2 size 0x80 — HDSL Safe Channel 2 Interface Registers
0x4000DB80 HDSL_general size 0x100 — HIPERFACE DSL encoder interface module
0x4000E000 TIMER22 size 0x400
0x4000E400 TIMER23 size 0x400
0x4000E800 TIMER30 size 0x400
0x4000EC00 TIMER31 size 0x400
0x4000F000 TIMER50 size 0x400 — Basic-timers
0x4000F400 TIMER51 size 0x400
0x40010000 TIMER0 size 0x400 — Advanced-timers
0x40010400 TIMER7 size 0x400
0x40011000 USART0 size 0x400 — Universal synchronous/asynchronous receiver /transmitter
0x40011400 USART5 size 0x400
0x40012400 ADC0 size 0x400 — Analog-to-digital converter
0x40012800 ADC1 size 0x400 — Analog-to-digital converter
0x40012C00 ADC2 size 0x400 — Analog-to-digital converter
0x40013000 SPI0 size 0x400 — Serial peripheral interface/Inter-IC sound
0x40013400 SPI3 size 0x400 — Serial peripheral interface/Inter-IC sound
0x40013800 SPI5 size 0x400 — Serial peripheral interface/Inter-IC sound
0x40014000 TIMER14 size 0x400 — General-purpose-timers
0x40014400 TIMER15 size 0x400 — General-purpose-timers
0x40014800 TIMER16 size 0x400
0x40015000 SPI4 size 0x400 — Serial peripheral interface/Inter-IC sound
0x40015800 SAI0 size 0x400 — Serial Audio Interface
0x40015C00 SAI1 size 0x400
0x40016000 SAI2 size 0x400
0x40016400 RDCM size 0x400 — Resolver-to-digital module
0x40016800 SAI3 size 0x400
0x40017000 HPDF size 0x400 — High Performance Digital Filter
0x40018400 TRIGSEL size 0x400 — Trigger selection controller
0x40018800 EDOUT size 0x400 — En-coder Divided-Output controller
0x4001A000 CAN0 size 0x1000 — Controller area network
0x4001B000 CAN1 size 0x1000
0x4001C000 CAN2 size 0x1000
0x4001D000 TIMER40 size 0x400
0x4001D400 TIMER41 size 0x400
0x4001D800 TIMER42 size 0x400
0x4001DC00 TIMER43 size 0x400
0x4001F000 TIMER44 size 0x400
0x40020000 DMA0 size 0x400 — Direct memory access controller
0x40020400 DMA1 size 0x400
0x40020800 DMAMUX size 0x400 — DMA request multiplexer
0x40028000 ENET0_MAC size 0x100 — Ethernet: media access control
0x40028100 ENET0_MSC size 0x400 — Ethernet: MAC statistics counters
0x40028700 ENET0_PTP size 0x400 — Ethernet: Precision time protocol
0x40029000 ENET0_DMA size 0x60 — Ethernet: DMA controller operation
0x40029080 ENET0_MAC_FCTH size 0x20 — MAC flow control threshold register
0x4002A000 ENET1_MAC size 0x100 — Ethernet: media access control
0x4002A100 ENET1_MSC size 0x400 — Ethernet: MAC statistics counters
0x4002A700 ENET1_PTP size 0x400 — Ethernet: Precision time protocol
0x4002B000 ENET1_DMA size 0x60 — Ethernet: DMA controller operation
0x4002B080 ENET1_MAC_FCTH size 0x20 — MAC flow control threshold register
0x40040000 USBHS0_GLOBAL size 0x400 — USB high speed global registers
0x40040400 USBHS0_HOST size 0x400 — USB on the go high speed host
0x40040800 USBHS0_DEVICE size 0x400 — USB on the go high speed device
0x40040E00 USBHS0_PWRCLK size 0x100 — USB on the go high speed
0x40080000 USBHS1_GLOBAL size 0x400 — USB high speed global registers
0x40080400 USBHS1_HOST size 0x400 — USB on the go high speed host
0x40080800 USBHS1_DEVICE size 0x400 — USB on the go high speed device
0x40080E00 USBHS1_PWRCLK size 0x100 — USB on the go high speed
0x48000000 PKCAU size 0x400 — Public Key Cryptographic Acceleration Unit
0x48020000 DCI size 0x200 — Digital Camera Interface
0x48020200 GPSI size 0x200 — General parallel slaver interfac
0x48021000 CAU size 0x400 — Cryptographic acceleration unit
0x48021400 HAU size 0x400 — HAU acceleration unit
0x48021800 TRNG size 0x400 — True random number generator
0x48022400 SDIO1 size 0x400
0x48022800 CPDM_SDIO1 size 0x400
0x48023000 RAMECCMU1 size 0x100 — RAM ECC monitor unit 1
0x48024000 FFT size 0x400 — Fast Fourier Transform
0x48024400 TMU size 0x400 — Trigonometric Math Unit
0x48024800 FAC size 0x400 — Filter arithmetic accelerator
0x50001000 TLI size 0x400 — TFT-LCD interface
0x50003000 WWDGT size 0x400 — Window watchdog timer
0x51000000 AXI size 0x100000 — System and memory architectur
0x52000000 MDMA size 0x800 — Master direct memory access controller
0x52001000 IPA size 0xC00 — Image processing accelerator
0x52002000 NVMC size 0x400 — Non-volatile memory controller
0x52003000 DSI size 0x400 — DSI host controller
0x52004000 EXMC size 0x400 — External memory controller
0x52005000 OSPI0 size 0x400 — Octal-SPI Interface 0
0x52006000 CPDM_OSPI0 size 0x400
0x52007000 SDIO0 size 0x400 — Secure digital input/output interface 0
0x52008000 CPDM_SDIO0 size 0x400 — SDIO0 clock phase delay module
0x52009000 RAMECCMU0 size 0x100 — RAM ECC monitor unit0
0x5200A000 OSPI1 size 0x400
0x5200B000 CPDM_OSPI1 size 0x400
0x5200B400 OSPIM size 0x400 — OSPI I/O Manager
0x5200B800 RTDEC0 size 0x400 — Real-time decryption
0x5200BC00 RTDEC1 size 0x400 — Real-time decryption
0x58000000 EXTI size 0x400 — External interrupt/event controller
0x58000400 SYSCFG size 0x400 — System and memory architectur
0x58003800 CMP size 0x400 — Comparator
0x58003C00 VREF size 0x400
0x58004000 RTC size 0x400 — Real-time clock
0x58004800 FWDGT size 0x400 — free watchdog timer
0x58005800 PMU size 0x400 — Power management unit
0x58006800 LPDTS size 0x400 — Lower power digital temperature sensor
0x58020000 GPIOA size 0x400 — General-purpose I/Os
0x58020400 GPIOB size 0x400 — General-purpose I/Os
0x58020800 GPIOC size 0x400 — General-purpose I/Os
0x58020C00 GPIOD size 0x400
0x58021000 GPIOE size 0x400
0x58021400 GPIOF size 0x400
0x58021800 GPIOG size 0x400
0x58021C00 GPIOH size 0x400
0x58022400 GPIOJ size 0x400
0x58022800 GPIOK size 0x400
0x58024400 RCU size 0x400 — Reset and clock unit
0x58024C00 CRC size 0x400 — CRC calculation unit
0x58026400 HWSEM size 0x400 — Hardware semaphore
0x5F000000 ESC size 0x4000 — EtherCAT SubDevice Controller
0xE000E100 NVIC size 0x401 — Nested Vectored Interrupt Controller
0xE00E1000 DBG size 0x400 — Debug

## Interrupts
0 WWDGT
1 AVD_PVD (PMU)
2 RTC_Tamper_Timestamp (RTC)
3 RTC_WAKE (RTC)
4 NVMC
5 RCU
6 EXTI_Line0 (EXTI)
7 EXTI_Line1 (EXTI)
8 EXTI_Line2 (EXTI)
9 EXTI_Line3 (EXTI)
10 EXTI_Line4 (EXTI)
11 DMA0_Channel0 (DMA0)
12 DMA0_Channel1 (DMA0)
13 DMA0_Channel2 (DMA0)
14 DMA0_Channel3 (DMA0)
15 DMA0_Channel4 (DMA0)
16 DMA0_Channel5 (DMA0)
17 DMA0_Channel6 (DMA0)
18 ADC0_1 (ADC{n} (n=0..2))
23 EXTI_line9_5 (EXTI)
24 TIMER0_BRK (TIMER0)
25 TIMER0_UP (TIMER0)
26 TIMER0_TR_CM (TIMER0)
27 TIMER0_CAP (TIMER0)
28 TIMER1
29 TIMER2
30 TIMER3
31 I2C0_EV (I2C0)
32 I2C0_ER (I2C0)
33 I2C1_EV (I2C1)
34 I2C1_ER (I2C1)
35 SPI0
36 SPI1
37 USART0
38 USART1
39 USART2
40 EXTI_line15_10 (EXTI)
41 RTC_Alarm (RTC)
43 TIMER7_BRK (TIMER7)
44 TIMER7_UP (TIMER7)
45 TIMER7_TR_CM (TIMER7)
46 TIMER7_CAP (TIMER7)
47 DMA0_Channel7 (DMA0)
48 EXMC_GLOBAL (EXMC)
49 SDIO0
50 TIMER4
51 SPI2
52 UART3
53 UART4
54 TIMER5_DAC (DAC0, TIMER5)
55 TIMER6
56 DMA1_Channel0 (DMA1)
57 DMA1_Channel1 (DMA1)
58 DMA1_Channel2 (DMA1)
59 DMA1_Channel3 (DMA1)
60 DMA1_Channel4 (DMA1)
61 ENET0 (ENET0_MAC)
62 ENET0_WKUP (ENET0_MAC)
68 DMA1_Channel5 (DMA1)
69 DMA1_Channel6 (DMA1)
70 DMA1_Channel7 (DMA1)
71 USART5
72 I2C2_EV (I2C2)
73 I2C2_ER (I2C2)
74 USBHS0_EP1_OUT (USBHS0_GLOBAL)
75 USBHS0_EP1_IN (USBHS0_GLOBAL)
76 USBHS0_WAKEUP (USBHS0_GLOBAL)
77 USBHS0_GLOBAL
78 DCI
79 CAU
80 HAU_TRNG (HAU, TRNG)
82 UART6
83 UART7
84 SPI3
85 SPI4
86 SPI5
87 SAI0
88 TLI
89 TLI_ER (TLI)
90 IPA
91 SAI1
92 OSPI0
95 I2C3_EV (I2C3)
96 I2C3_ER (I2C3)
97 RSPDIF
102 DMAMUX0 (DMAMUX)
110 HPDF_GLOBAL0 (HPDF)
111 HPDF_GLOBAL1 (HPDF)
112 HPDF_GLOBAL2 (HPDF)
113 HPDF_GLOBAL3 (HPDF)
114 SAI2
116 TIMER14
117 TIMER15
118 TIMER16
120 MDIO_GLOBAL (MDIO)
122 MDMA_GLOBAL (MDMA)
124 SDIO1
125 HWSEM_GLOBAL (HWSEM)
137 CPM_GLOBAL (CMP)
144 CTC
145 ECC (RAMECCMU0)
146 SAI3
150 OSPI1
151 RTDEC0_GLOBAL (RTDEC0)
152 RTDEC1_GLOBAL (RTDEC1)
153 FAC_GLOBAL (FAC)
154 TMU_GLOBAL (TMU)
161 TIMER22
162 TIMER23
163 TIMER30
164 TIMER31
165 TIMER40
166 TIMER41
167 TIMER42
168 TIMER43
169 TIMER44
170 TIMER50
171 TIMER51
172 USBHS1_EP1_OUT (USBHS1_GLOBAL)
173 USBHS1_EP1_IN (USBHS1_GLOBAL)
174 USBHS1_WAKEUP (USBHS1_GLOBAL)
175 USBHS1_GLOBAL
176 ENET1 (ENET1_MAC)
177 ENET1_WKUP (ENET1_MAC)
179 CAN0_WK (CAN0)
180 CAN0_BUFF (CAN0)
181 CAN0_BUSOFF (CAN0)
182 CAN0_ERROR (CAN0)
183 CAN0_ERROR_FTX (CAN0)
184 CAN0_WARNING_TX (CAN0)
185 CAN0_WARNING_RX (CAN0)
186 CAN1_WK (CAN1)
187 CAN1_BUFF (CAN1)
188 CAN1_BUSOFF (CAN1)
189 CAN1_ERROR (CAN1)
190 CAN1_ERROR_FTX (CAN1)
191 CAN1_WARNING_TX (CAN1)
192 CAN1_WARNING_RX (CAN1)
193 CAN2_WK (CAN2)
194 CAN2_BUFF (CAN2)
195 CAN2_BUSOFF (CAN2)
196 CAN2_ERROR (CAN2)
197 CAN2_ERROR_FTX (CAN2)
198 CAN2_WARNING_TX (CAN2)
199 CAN2_WARNING_RX (CAN2)
201 I2C0_WAKE (I2C0)
202 I2C1_WAKE (I2C1)
203 I2C2_WAKE (I2C2)
204 I2C3_WAKE (I2C3)
205 LPDTS
206 LPDTS_WAKE (LPDTS)
207 TIMER0_DEC (TIMER0)
208 TIMER7_DEC (TIMER7)
209 TIMER1_DEC (TIMER1)
210 TIMER2_DEC (TIMER2)
211 TIMER3_DEC (TIMER3)
212 TIMER4_DEC (TIMER4)
213 TIMER22_DEC (TIMER22)
214 TIMER23_DEC (TIMER23)
215 TIMER30_DEC (TIMER30)
216 TIMER31_DEC (TIMER31)
217 CPU_DCACHE (SYSCFG)
218 CPU_ICACHE (SYSCFG)
219 VCORE (SYSCFG)
223 DSI
224 PKCAU
225 ESC
226 EDIM (SAFE_CHANNEL_1)
